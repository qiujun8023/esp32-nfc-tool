## main/Kconfig.projbuild
```kconfig
menu "NFC Tool Configuration"

    config ESP_WIFI_SSID
        string "WiFi SoftAP SSID"
        default "ESP32-NFC-Tool"
        help
            SSID of the SoftAP the tool will host for the web UI.

    config ESP_WIFI_PASSWORD
        string "WiFi SoftAP Password"
        default ""
        help
            Password of the SoftAP. Leave empty to run OPEN.

    config ESP_MAX_STA_CONN
        int "Maximal STA connections"
        default 4
        range 1 10
        help
            Max number of stations that can connect to the SoftAP concurrently.

endmenu
```

## sdkconfig.defaults
```kconfig
# ---- 目标芯片 ----
CONFIG_IDF_TARGET="esp32c3"

# ---- Flash ----
CONFIG_ESPTOOLPY_FLASHSIZE_4MB=y
CONFIG_ESPTOOLPY_FLASHSIZE="4MB"

# ---- 分区表（双 OTA + storage）----
CONFIG_PARTITION_TABLE_CUSTOM=y
CONFIG_PARTITION_TABLE_CUSTOM_FILENAME="partitions.csv"
CONFIG_PARTITION_TABLE_FILENAME="partitions.csv"

# ---- CPU / FreeRTOS ----
CONFIG_FREERTOS_HZ=1000
CONFIG_ESP_MAIN_TASK_STACK_SIZE=8192

# ---- HTTP Server ----
CONFIG_HTTPD_WS_SUPPORT=y
CONFIG_HTTPD_MAX_REQ_HDR_LEN=1024
CONFIG_HTTPD_MAX_URI_LEN=512

# ---- WiFi / 网络 ----
# 浏览器并发拉静态资源 + WebSocket 长连接容易把默认 10 打满
CONFIG_LWIP_MAX_SOCKETS=16
```
